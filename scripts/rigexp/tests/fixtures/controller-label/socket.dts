/dts-v1/;

#include <dt-bindings/connector/fixture-nexus.h>

/* Synthetic fixture for the controller-label determinism invariant: a
 * shared controller node carries TWO labels, attached in this textual
 * order -- defining_ctrl on the node itself (as a real SoC dtsi gives a
 * controller its primary label), legacy_alias appended afterward via a
 * bare label-ref (as a later-composed module attaching a legacy per-pin
 * alias would do; dtlib's label list is append-only and never reordered).
 * A pwm-map/gpio-map consumer resolving this node must always see the
 * FIRST-attached label, never whichever alias happened to attach last.
 *
 * The socket node's compatible is this fixture's OWN purpose-built
 * connector type (bindings/fixture-nexus.yaml), not the real
 * "socket,grove" -- the real connector types all include: Zephyr's own
 * gpio-nexus.yaml/base.yaml, which this test must not depend on. This test
 * reads the type only via --bindings-dir/--include-dir (board_edt.py, plain
 * edtlib), never through ctypes_registry.py's registry -- see
 * fixtures/reference-shields for the registry-visible use of the SAME
 * file. */
/ {
	model = "Controller-Label Fixture Board";
	compatible = "vnd,controller-label-fixture";

	defining_ctrl: shared_ctrl {
		#gpio-cells = <2>;
		#pwm-cells = <2>;
	};

	fixture_socket: connector_fixture_x {
		compatible = "socket,fixture-nexus";
		#gpio-cells = <2>;
		gpio-map-mask = <0xffffffff 0xffffffc0>;
		gpio-map-pass-thru = <0 0x3f>;
		gpio-map = <FIXTURE_POS0 0 &defining_ctrl 0 0>;

		#pwm-cells = <2>;
		pwm-map-mask = <0xffffffff 0x00000000>;
		pwm-map-pass-thru = <0x00000000 0xffffffff>;
		pwm-map = <FIXTURE_POS0 0 &defining_ctrl 0 0>;
	};
};

legacy_alias: &defining_ctrl {};
