/* generated by rigc — do not edit; the rig file is the source of truth
 * rig: grove_sens_pinned  board: m5stack_nanoc6/esp32c6/hpcore/rig
 */

&i2c0 {
	sensor_a_gsbme_dev: sensor@77 {
		compatible = "bosch,bme280";
		friendly-name = "Grove THP Sensor V1.0 (BME280)";
		reg = <0x77>;
		status = "okay";
	};
};
