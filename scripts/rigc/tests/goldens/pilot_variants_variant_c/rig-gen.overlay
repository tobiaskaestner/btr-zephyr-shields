/* generated by rigc — do not edit; the rig file is the source of truth (R3)
 * rig: pilot_variants  board: nucleo_f401re/stm32f401xe/rig
 */

/ {
	gpio_keys: gpio_keys {
		compatible = "gpio-keys";
		logger_pab_key: logger_pab_key {
			label = "logger_pab_key";
			zephyr,code = <5>;
			gpios = <&nucleo_ard 8 0x20>;	/* D2 */
		};
	};
};
