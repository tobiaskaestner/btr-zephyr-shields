## boards/seeed/seeeduino_lotus_btr/board.yml
```yaml
board:
  name: seeeduino_lotus_btr
  full_name: Seeeduino Lotus Cortex-M0+ (btr-shields clone, rigs Convention 4 socket nodes)
  vendor: seeed
  socs:
    - name: samd21g18a
```

## boards/shields/arduino_lcd/Kconfig.shield
```kconfig
# SPDX-License-Identifier: Apache-2.0

config SHIELD_LCD_CHAR_1602
	def_bool $(shields_list_contains,lcd_char_1602)

config SHIELD_LCD_TFT_24
	def_bool $(shields_list_contains,lcd_tft_24)
```

## boards/shields/grove_led/Kconfig.shield
```kconfig
# SPDX-License-Identifier: Apache-2.0

config SHIELD_GROVE_LED
	def_bool $(shields_list_contains,grove_led)

config SHIELD_GROVE_PWM_LED
	def_bool $(shields_list_contains,grove_pwm_led)
```

## boards/shields/grove_light/Kconfig.shield
```kconfig
# SPDX-License-Identifier: Apache-2.0

config SHIELD_GROVE_LIGHT
	def_bool $(shields_list_contains,grove_light)
```

## boards/shields/grove_sens/Kconfig.shield
```kconfig
# SPDX-License-Identifier: Apache-2.0

config SHIELD_GROVE_SENS_BME280
	def_bool $(shields_list_contains,grove_sens_bme280)

config SHIELD_GROVE_SENS_BMP280
	def_bool $(shields_list_contains,grove_sens_bmp280)

config SHIELD_GROVE_SENS_DPS310
	def_bool $(shields_list_contains,grove_sens_dps310)
```

## boards/shields/grove_servo/Kconfig.shield
```kconfig
# SPDX-License-Identifier: Apache-2.0

config SHIELD_GROVE_SERVO
	def_bool $(shields_list_contains,grove_servo)
```

## boards/shields/i2c_mux/Kconfig.shield
```kconfig
# SPDX-License-Identifier: Apache-2.0

config SHIELD_I2C_MUX
	def_bool $(shields_list_contains,i2c_mux)
```

## boards/shields/mikrobus_span_adapter/Kconfig.shield
```kconfig
# SPDX-License-Identifier: Apache-2.0

config SHIELD_MIKROBUS_SPAN_ADAPTER
	def_bool $(shields_list_contains,mikrobus_span_adapter)
```

## boards/shields/temp_click/Kconfig.shield
```kconfig
# SPDX-License-Identifier: Apache-2.0

config SHIELD_TEMP_CLICK
	def_bool $(shields_list_contains,temp_click)
```

## boards/shields/temp_hum_click/Kconfig.shield
```kconfig
# SPDX-License-Identifier: Apache-2.0

config SHIELD_TEMP_HUM_CLICK
	def_bool $(shields_list_contains,temp_hum_click)
```

## boards/st/nucleo_f401re_btr/board.yml
```yaml
board:
  name: nucleo_f401re_btr
  full_name: Nucleo F401RE (btr-shields clone, rigs Convention 4 socket node)
  vendor: st
  socs:
    - name: stm32f401xe
```

## dts/bindings/test/vnd,light-sensor.yaml
```yaml
# SPDX-License-Identifier: Apache-2.0

description: |
  Test ADC light-sensor consumer (rig corpus, lotus_pwm). Minimal typed
  binding so pass-2's edtlib resolves `io-channels` through the real
  io-channel-map nexus (Bridge-A rewrite step 2a) instead of leaving the
  property untyped (see vnd,pwm-servo.yaml for the full rationale).

compatible: "vnd,light-sensor"

properties:
  io-channels:
    type: phandle-array
    required: true
```

## dts/bindings/test/vnd,pwm-servo.yaml
```yaml
# SPDX-License-Identifier: Apache-2.0

description: |
  Test PWM servo consumer (rig corpus, lotus-pwm/lotus-pwm-clash). Minimal
  typed binding so pass-2's edtlib resolves `pwms` through the real
  pwm-map nexus (Bridge-A rewrite step 2a) instead of leaving the property
  untyped — without a declared `type: phandle-array`, edtlib never attempts
  nexus resolution on it at all (the corpus gap step 2b's review found).

compatible: "vnd,pwm-servo"

properties:
  pwms:
    type: phandle-array
    required: true
```

## scripts/rigc/tests/fixtures/dts/bindings/fixturetest-adc-ctrl.yaml
```yaml
description: Purpose-built fixture ADC controller binding (rigc's own
  board/project.py's and board/resolve.py's unit-test data, never a copy of
  a real controller binding).

compatible: "fixturetest,adc-ctrl"

properties:
  reg:
    type: array
  "#io-channel-cells":
    type: int
    required: true

io-channel-cells:
  - input
```

## scripts/rigc/tests/fixtures/dts/bindings/fixturetest-i2c-ctrl.yaml
```yaml
description: Purpose-built fixture I2C controller binding (rigc's own
  board/project.py's and board/resolve.py's unit-test data, never a copy of
  a real controller binding).

compatible: "fixturetest,i2c-ctrl"

properties:
  reg:
    type: array
  "#address-cells":
    type: int
  "#size-cells":
    type: int
```

## scripts/rigc/tests/fixtures/dts/bindings/socket-fixture-nexus.yaml
```yaml
description: |
  Purpose-built fixture connector-type binding for rigc's own board_edt/
  boarddt unit tests (tests/unit/test_board_edt.py, tests/unit/
  test_boarddt.py) -- never a copy of a real dts/bindings/connectors/
  *.yaml type (rigc-mission-brief.md Sec 7: hermetic means no Zephyr
  DATA). Declares exactly the nexus shapes board_edt.py's projection
  reads: gpio-map (required, every socket has one), pwm-map/
  io-channel-map (optional, only PWM/ADC-capable sockets carry them),
  socket,i2c (a bus proxy phandle), socket,cs-pool (the CS pool
  default).

compatible: "socket,fixture-nexus"

properties:
  socket,i2c:
    type: phandle
    description: the I2C controller this socket exposes, if any

  socket,cs-pool:
    type: array
    description: ordered default CS candidate positions

  "#gpio-cells":
    type: int
    required: true

  gpio-map:
    type: compound
    required: true

  gpio-map-mask:
    type: array

  gpio-map-pass-thru:
    type: array

  "#pwm-cells":
    type: int

  pwm-map:
    type: compound

  pwm-map-mask:
    type: array

  pwm-map-pass-thru:
    type: array

  "#io-channel-cells":
    type: int

  io-channel-map:
    type: compound

  io-channel-map-mask:
    type: array

  io-channel-map-pass-thru:
    type: array
```
