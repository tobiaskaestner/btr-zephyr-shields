/*
 * Board-DT fragment: NXP FRDM-K64F typed Arduino R3 socket node (rigs
 * Convention 4 — typed sockets live in the board's own devicetree).
 *
 * Layered on top of the REAL upstream frdm_k64f.dts by the `rig` board
 * EXTENSION variant (board.yml `extend:`) -- included from
 * frdm_k64f_mk64f12_rig.dts, alongside the base board's own legacy
 * `arduino_header` connector nexus (unmodified, it comes along for free via
 * the base include -- harmless duplication, not referenced by this
 * socket). The base board's arduino_i2c/arduino_spi/arduino_serial blocks
 * (real bus config: status/pinctrl + the onboard fxos8700, not connector
 * geometry) are untouched, and socket,i2c/spi/uart point at those same
 * controllers (&i2c0/&spi0/&uart3) directly.
 *
 * Content identical to the board clone's own arduino_r3_socket.dtsi --
 * copied in here so the extension has no long-term dependency on the
 * clone (deleted in full, slice E4, board-extension-migration.md).
 *
 * gpio-map child pins use the upstream index header
 * (<zephyr/dt-bindings/gpio/arduino-header-r3.h>) — the
 * position-index single source of truth (Convention 4).
 *
 * Labels/positions match the scenario rigs (S6).
 *
 * SPDX-License-Identifier: Apache-2.0
 */

#include <zephyr/dt-bindings/gpio/arduino-header-r3.h>

/ {
	frdm_ard: arduino_r3: connector_arduino_r3 {
		compatible = "socket,arduino-r3";
		#gpio-cells = <2>;
		gpio-map-mask = <0xffffffff 0xffffffc0>;
		gpio-map-pass-thru = <0 0x3f>;
		gpio-map = <ARDUINO_HEADER_R3_A0 0 &gpiob 2 0>,
			   <ARDUINO_HEADER_R3_A1 0 &gpiob 3 0>,
			   <ARDUINO_HEADER_R3_A2 0 &gpiob 10 0>,
			   <ARDUINO_HEADER_R3_A3 0 &gpiob 11 0>,
			   <ARDUINO_HEADER_R3_A4 0 &gpioc 11 0>,
			   <ARDUINO_HEADER_R3_A5 0 &gpioc 10 0>,
			   <ARDUINO_HEADER_R3_D0 0 &gpioc 16 0>,
			   <ARDUINO_HEADER_R3_D1 0 &gpioc 17 0>,
			   <ARDUINO_HEADER_R3_D2 0 &gpiob 9 0>,
			   <ARDUINO_HEADER_R3_D3 0 &gpioa 1 0>,
			   <ARDUINO_HEADER_R3_D4 0 &gpiob 23 0>,
			   <ARDUINO_HEADER_R3_D5 0 &gpioa 2 0>,
			   <ARDUINO_HEADER_R3_D6 0 &gpioc 2 0>,
			   <ARDUINO_HEADER_R3_D7 0 &gpioc 3 0>,
			   /* NOTE: HW Rev E and on use PTC12 (matches legacy) */
			   <ARDUINO_HEADER_R3_D8 0 &gpioc 12 0>,
			   <ARDUINO_HEADER_R3_D9 0 &gpioc 4 0>,
			   <ARDUINO_HEADER_R3_D10 0 &gpiod 0 0>,
			   <ARDUINO_HEADER_R3_D11 0 &gpiod 2 0>,
			   <ARDUINO_HEADER_R3_D12 0 &gpiod 3 0>,
			   <ARDUINO_HEADER_R3_D13 0 &gpiod 1 0>,
			   <ARDUINO_HEADER_R3_D14 0 &gpioe 25 0>,
			   <ARDUINO_HEADER_R3_D15 0 &gpioe 24 0>;
		socket,i2c = <&i2c0>;
		socket,spi = <&spi0>;
		socket,uart = <&uart3>;
		socket,stackable;

		/* L4-ADC (item 35): A0-A3 reach real ADC channels, split across
		 * TWO controllers (&adc0 for A0/A1, &adc1 for A2/A3) -- the
		 * multi-parent io-channel-map the brief expected on this SoC.
		 * Channel numbers sourced from the Kinetis pin-mux header
		 * modules/hal/nxp/dts/nxp/kinetis/MK64FN1M0VLL12-pinctrl.h's own
		 * ADCn_SEc_PTxy macro names (c = the channel number), matched
		 * against the pin each position reaches per this file's own
		 * gpio-map above (PTB2/PTB3/PTB10/PTB11):
		 *   A0 PTB2  -> ADC0_SE12_PTB2  (adc0 channel 12)
		 *   A1 PTB3  -> ADC0_SE13_PTB3  (adc0 channel 13)
		 *   A2 PTB10 -> ADC1_SE14_PTB10 (adc1 channel 14)
		 *   A3 PTB11 -> ADC1_SE15_PTB11 (adc1 channel 15)
		 * A4 (PTC11) and A5 (PTC10) are DECLARED BY ABSENCE, the same
		 * subset-exposure rule socket,uart already applies elsewhere in
		 * this file: their only channel macros in that same header are
		 * ADC1_SE7b_PTC11 / ADC1_SE6b_PTC10 -- the trailing "b" means
		 * they are reachable ONLY through &adc1's alternate input mux
		 * (the "channel-mux-b" property dts/bindings/adc/
		 * nxp,kinetis-adc16.yaml declares, a CONTROLLER-WIDE selection,
		 * not a per-channel one). Channels 14/15 above have no such
		 * alternate (no ADC1_SE14b/SE15b macro exists in the header),
		 * so setting channel-mux-b to reach A4/A5 would not disturb
		 * them -- but authoring that property is itself the same
		 * board-provided pin-routing work Sec 4 stubs out for pinctrl
		 * groups, with no upstream fact (no existing pinctrl group
		 * routes either pin to an ADC input today), so it stays out of
		 * this slice rather than being invented.
		 * &adc0/&adc1 (dts/arm/nxp/kinetis/nxp_k6x.dtsi, compatible
		 * "nxp,kinetis-adc16") both declare #io-channel-cells = <1>,
		 * matching this socket's own -- no pass-thru bits needed. Pin-
		 * mux stays stubbed per Sec 4 regardless: the upstream board's
		 * own adc0_default (ADC0_SE14_PTC0, an unrelated non-Arduino
		 * pin) and adc1_default (ADC1_SE14_PTB10 -- coincidentally
		 * A2's own pin/channel, but wired there for whatever consumer
		 * adc1_default already served, not authored by this slice) are
		 * left untouched; A0, A1, and A3 have no pinctrl group of their
		 * own at all, same as A4/A5 above. */
		#io-channel-cells = <1>;
		io-channel-map-mask = <0xffffffff>;
		io-channel-map-pass-thru = <0x00000000>;
		io-channel-map = <ARDUINO_HEADER_R3_A0 &adc0 12>,
				  <ARDUINO_HEADER_R3_A1 &adc0 13>,
				  <ARDUINO_HEADER_R3_A2 &adc1 14>,
				  <ARDUINO_HEADER_R3_A3 &adc1 15>;

		/* L4-PWM (item 36): eight of the twelve digital positions reach a
		 * real FTM channel, split across TWO controllers (&ftm0 for
		 * D3/D5/D6/D7/D9, &ftm3 for D10/D11/D12/D13) -- the multi-parent
		 * io-channel-map above already proved this shape for ADC on this
		 * same SoC; this map independently confirms it holds for PWM too
		 * (per the brief's own instruction not to assume the ADC result
		 * transfers). Channel numbers sourced from the SAME Kinetis
		 * pin-mux header ADC used, modules/hal/nxp/dts/nxp/kinetis/
		 * MK64FN1M0VLL12-pinctrl.h, this time its own FTM<n>_CH<m>_PT<x><n>
		 * macro names, matched against this file's own gpio-map pins
		 * above (PTA1/PTA2/PTC2/PTC3/PTC4/PTD0/PTD1/PTD2/PTD3):
		 *   D3  PTA1 -> FTM0_CH6_PTA1  (&ftm0 ch6)
		 *   D5  PTA2 -> FTM0_CH7_PTA2  (&ftm0 ch7)
		 *   D6  PTC2 -> FTM0_CH1_PTC2  (&ftm0 ch1)
		 *   D7  PTC3 -> FTM0_CH2_PTC3  (&ftm0 ch2)
		 *   D9  PTC4 -> FTM0_CH3_PTC4  (&ftm0 ch3)
		 *   D10 PTD0 -> FTM3_CH0_PTD0  (&ftm3 ch0)
		 *   D11 PTD2 -> FTM3_CH2_PTD2  (&ftm3 ch2)
		 *   D12 PTD3 -> FTM3_CH3_PTD3  (&ftm3 ch3)
		 *   D13 PTD1 -> FTM3_CH1_PTD1  (&ftm3 ch1)
		 * Channel numbering cross-checked against this board's OWN
		 * already-real pin-mux (frdm_k64f-pinctrl.dtsi's ftm0_default /
		 * ftm3_default): `pinmux = <FTM0_CH0_PTC1>;` for ftm0_default and
		 * `<FTM3_CH4_PTC8>, <FTM3_CH5_PTC9>;` for ftm3_default confirm the
		 * macro's own "CHn" digit IS the #pwm-cells channel value used
		 * with these exact controllers today (PTC1/PTC8/PTC9 are
		 * unrelated non-Arduino pins, left untouched, same as item 35's
		 * adc0_default/adc1_default note).
		 * D2 (PTB9), D4 (PTB23), and D8 (PTC12) are DECLARED BY ABSENCE:
		 * PTB9's only macros are SPI1_PCS1/UART3_CTS_b (no FTM_CH* at
		 * all); PTB23's are SPI2_SIN/SPI0_PCS5 (same); PTC12's ONLY FTM
		 * macro is FTM3_FLT0_PTC12 -- a FAULT/break INPUT, not a PWM
		 * output channel, so it carries no usable #pwm-cells channel
		 * either. None of the three has an alternate route -- this is
		 * "not timer-capable at all," not a clash to avoid (contrast
		 * nucleo's D4/D12, excluded for a channel-clash reason instead;
		 * see that file's own comment).
		 * &ftm0/&ftm3 (dts/arm/nxp/kinetis/nxp_k6x.dtsi, compatible
		 * "nxp,ftm", overridden to "nxp,ftm-pwm" + #pwm-cells = <3> by
		 * frdm_k64f.dts itself) are ALREADY real top-level labels --
		 * unlike nucleo's TIM1/TIM3/TIM4, no label needs adding here.
		 * Pin-mux for these eight positions is board-provided and stays
		 * STUBBED per Sec 4, same ruling as the ADC map above: this
		 * board wires exactly two PWM pinctrl groups today
		 * (ftm0_default/ftm3_default, both for unrelated non-Arduino
		 * pins), and authoring eight more is board work with no
		 * upstream fact behind it. */
		#pwm-cells = <3>;
		pwm-map-mask = <0xffffffff 0x00000000 0x00000000>;
		pwm-map-pass-thru = <0x00000000 0xffffffff 0xffffffff>;
		pwm-map = <ARDUINO_HEADER_R3_D3  0 0 &ftm0 6 0 0>,
			   <ARDUINO_HEADER_R3_D5  0 0 &ftm0 7 0 0>,
			   <ARDUINO_HEADER_R3_D6  0 0 &ftm0 1 0 0>,
			   <ARDUINO_HEADER_R3_D7  0 0 &ftm0 2 0 0>,
			   <ARDUINO_HEADER_R3_D9  0 0 &ftm0 3 0 0>,
			   <ARDUINO_HEADER_R3_D10 0 0 &ftm3 0 0 0>,
			   <ARDUINO_HEADER_R3_D11 0 0 &ftm3 2 0 0>,
			   <ARDUINO_HEADER_R3_D12 0 0 &ftm3 3 0 0>,
			   <ARDUINO_HEADER_R3_D13 0 0 &ftm3 1 0 0>;
	};
};
