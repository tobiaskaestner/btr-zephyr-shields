## boards/extend/m5stack/m5stack_nanoc6/board.yml
```yaml
board:
  extend: m5stack_nanoc6
  variants:
    - name: rig
      qualifier: esp32c6/hpcore
```

## boards/extend/mikroe/quail/board.yml
```yaml
board:
  extend: mikroe_quail
  variants:
    - name: rig
      qualifier: stm32f427xx
```

## boards/extend/seeed/seeeduino_lotus/board.yml
```yaml
board:
  extend: seeeduino_lotus
  variants:
    - name: rig
      qualifier: samd21g18a
```

## boards/extend/st/nucleo_f401re/board.yml
```yaml
board:
  extend: nucleo_f401re
  variants:
    - name: rig
      qualifier: stm32f401xe
```

## boards/mikroe/mikroe_quail_btr/board.yml
```yaml
board:
  name: mikroe_quail_btr
  full_name: MikroE Quail (btr-shields clone, rigs Convention 4 socket nodes)
  vendor: mikroe
  socs:
    - name: stm32f427xx
```

## boards/nxp/frdm_k64f_btr/Kconfig.frdm_k64f_btr
```kconfig
# Copyright 2024 NXP
# Copyright (c) 2025 ThoseBoards
# SPDX-License-Identifier: Apache-2.0

config BOARD_FRDM_K64F_BTR
	select SOC_MK64F12
	select SOC_PART_NUMBER_MK64FN1M0VLL12
```

## boards/nxp/frdm_k64f_btr/board.yml
```yaml
board:
  name: frdm_k64f_btr
  full_name: FRDM-K64F (btr-shields clone, rigs Convention 4 socket node)
  vendor: nxp
  socs:
    - name: mk64f12
```
