/*
 * Board-DT fragment: NXP FRDM-K64F typed Arduino R3 socket node
 * (rigs Convention 4 — typed sockets live in the board's own devicetree).
 *
 * This "socket,arduino-r3" node (label "frdm_ard") is the sole connector
 * description on this clone: the redundant legacy `arduino_header` nexus was
 * dropped from frdm_k64f_btr.dts. (The board's arduino_i2c/spi/serial blocks
 * remain — they are bus config, not connector geometry.) socket,i2c/spi/uart
 * point at the real controllers (&i2c0/&spi0/&uart3) directly.
 *
 * gpio-map child pins use the upstream index header
 * (<zephyr/dt-bindings/gpio/arduino-header-r3.h>) — the
 * position-index single source of truth (Convention 4).
 *
 * Labels/positions match the scenario rigs (S6) and the expander-side board
 * model at scripts/rigexp/common-dts/boards/frdm_k64f_btr.rig.dtsi
 * (Bridge-A; that file is a content clone of the pre-existing
 * frdm_k64f.rig.dtsi and is truncated to the positions the S6 chain uses).
 *
 * SPDX-License-Identifier: Apache-2.0
 */

#include <zephyr/dt-bindings/gpio/arduino-header-r3.h>

/ {
	frdm_ard: connector_arduino_r3 {
		compatible = "socket,arduino-r3";
		#gpio-cells = <2>;
		gpio-map-mask = <0xffffffff 0xffffffc0>;
		gpio-map-pass-thru = <0 0x3f>;
		gpio-map = <ARDUINO_HEADER_R3_A0 0 &gpiob 2 0>,
			   <ARDUINO_HEADER_R3_A1 0 &gpiob 3 0>,
			   <ARDUINO_HEADER_R3_A2 0 &gpiob 10 0>,
			   <ARDUINO_HEADER_R3_A3 0 &gpiob 11 0>,
			   <ARDUINO_HEADER_R3_A4 0 &gpioc 11 0>,
			   <ARDUINO_HEADER_R3_A5 0 &gpioc 10 0>,
			   <ARDUINO_HEADER_R3_D0 0 &gpioc 16 0>,
			   <ARDUINO_HEADER_R3_D1 0 &gpioc 17 0>,
			   <ARDUINO_HEADER_R3_D2 0 &gpiob 9 0>,
			   <ARDUINO_HEADER_R3_D3 0 &gpioa 1 0>,
			   <ARDUINO_HEADER_R3_D4 0 &gpiob 23 0>,
			   <ARDUINO_HEADER_R3_D5 0 &gpioa 2 0>,
			   <ARDUINO_HEADER_R3_D6 0 &gpioc 2 0>,
			   <ARDUINO_HEADER_R3_D7 0 &gpioc 3 0>,
			   /* NOTE: HW Rev E and on use PTC12 (matches legacy) */
			   <ARDUINO_HEADER_R3_D8 0 &gpioc 12 0>,
			   <ARDUINO_HEADER_R3_D9 0 &gpioc 4 0>,
			   <ARDUINO_HEADER_R3_D10 0 &gpiod 0 0>,
			   <ARDUINO_HEADER_R3_D11 0 &gpiod 2 0>,
			   <ARDUINO_HEADER_R3_D12 0 &gpiod 3 0>,
			   <ARDUINO_HEADER_R3_D13 0 &gpiod 1 0>,
			   <ARDUINO_HEADER_R3_D14 0 &gpioe 25 0>,
			   <ARDUINO_HEADER_R3_D15 0 &gpioe 24 0>;
		socket,i2c = <&i2c0>;
		socket,spi = <&spi0>;
		socket,uart = <&uart3>;
		socket,stackable;
	};
};
