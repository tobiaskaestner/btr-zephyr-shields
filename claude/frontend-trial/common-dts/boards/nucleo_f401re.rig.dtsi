/* Board-DT fragment: Nucleo-F401RE typed Arduino R3 socket.
 * REPLACES the legacy arduino_r3_connector.dtsi in the board's own DT —
 * this file is part of the BOARD tree (labels &i2c1/&spi1/&gpio* are real
 * phandles, dtc-validated; binding for "socket,arduino-r3" validates shape).
 * Carries the legacy labels so unconverted shields keep working (S1
 * guarantee): migration, not shim.
 * gpio-map child pins use the SAME header the shields reference —
 * the single source of truth for position indices.
 */

#include <dt-bindings/connector/arduino-r3.h>

/ {
	nucleo_ard: connector_arduino_r3: connector {
		compatible = "socket,arduino-r3";
		#gpio-cells = <2>;
		gpio-map-mask = <0xffffffff 0xffffffc0>;
		gpio-map-pass-thru = <0 0x3f>;
		/* trial: truncated to the positions the scenarios use */
		gpio-map = <ARDUINO_HEADER_R3_D2  0 &gpioa 10 0>,
			   <ARDUINO_HEADER_R3_D3  0 &gpiob 3  0>,
			   <ARDUINO_HEADER_R3_D4  0 &gpiob 5  0>,
			   <ARDUINO_HEADER_R3_D5  0 &gpiob 4  0>,
			   <ARDUINO_HEADER_R3_D6  0 &gpiob 10 0>,
			   <ARDUINO_HEADER_R3_D7  0 &gpioa 8  0>,
			   <ARDUINO_HEADER_R3_D8  0 &gpioa 9  0>,
			   <ARDUINO_HEADER_R3_D9  0 &gpioc 7  0>,
			   <ARDUINO_HEADER_R3_D10 0 &gpiob 6  0>;
		socket,i2c = <&i2c1>;
		socket,spi = <&spi1>;
		/* no socket,uart: subset exposure, declared by absence (S6) */
	};
};

/* legacy labels during migration — unconverted shields still work */
arduino_header: &connector_arduino_r3 {};
arduino_i2c: &i2c1 {};
arduino_spi: &spi1 {};
