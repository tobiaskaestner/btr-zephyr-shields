## CMakeLists.txt
```
# SPDX-License-Identifier: Apache-2.0

cmake_minimum_required(VERSION 3.20.0)
find_package(Zephyr REQUIRED HINTS $ENV{ZEPHYR_BASE})
project(can_span_click)

FILE(GLOB app_sources src/*.c)
target_sources(app PRIVATE ${app_sources})
```

## prj.conf
```kconfig
CONFIG_SPI=y
CONFIG_FLASH=y
CONFIG_ZTEST=y

# CAN_MCP2515 (can0's own driver) is probed clean but deliberately
# UNSELECTED here (multi-plug-promotion-brief.md Sec 5): it lives inside
# an `if CAN` menu with no `default y` of its own reachable without
# CONFIG_CAN, so without CONFIG_CAN=y it simply stays out of the build --
# inert, never a hard failure, matching how test_can_span_click_build_
# round_trip's own --cmake-only probe already found it (scripts/rigc/
# tests/integration/test_multiplug_shield.py). This suite exercises
# log_flash's own jedec,spi-nor side (CONFIG_SPI/CONFIG_FLASH, the exact
# combination flash_click's own suite already builds clean) rather than
# CAN, which is the honest Kconfig level a --build-only suite can claim
# for this shield without adding a full CAN network stack.
```

## src/main.c
```c
/*
 *
 * SPDX-License-Identifier: Apache-2.0
 */
#include <zephyr/ztest.h>

ZTEST(can_span_click, test_dummy)
{
}

ZTEST_SUITE(can_span_click, NULL, NULL, NULL, NULL, NULL);
```
