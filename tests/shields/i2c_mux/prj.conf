## CMakeLists.txt
```
# SPDX-License-Identifier: Apache-2.0

cmake_minimum_required(VERSION 3.20.0)
find_package(Zephyr REQUIRED HINTS $ENV{ZEPHYR_BASE})
project(i2c_mux)

FILE(GLOB app_sources src/*.c)
target_sources(app PRIVATE ${app_sources})
```

## prj.conf
```kconfig
CONFIG_I2C=y
CONFIG_ZTEST=y

# Promoted alone, the mux has no channel nodes: i2c_mux's four channels are
# `socket,i2c-port` SOCKETS, and a promoted shield is a single instance with
# nothing plugged into it. Zephyr's i2c_tca954x.c cannot compile against a
# childless mux -- `tca954x_channel_init` is referenced only from
# TCA954x_CHILD_DEFINE, so it trips -Werror=unused-function -- and no
# application-level Kconfig can fix that. The devicetree is still generated,
# validated and compiled, which is what this suite claims; only the driver
# is left out. Revisit when a rig (not a promotion) puts a device on a channel.
CONFIG_I2C_TCA954X=n
```

## src/main.c
```c
/*
 *
 * SPDX-License-Identifier: Apache-2.0
 */
#include <zephyr/ztest.h>

ZTEST(i2c_mux, test_dummy)
{
}

ZTEST_SUITE(i2c_mux, NULL, NULL, NULL, NULL, NULL);
```
