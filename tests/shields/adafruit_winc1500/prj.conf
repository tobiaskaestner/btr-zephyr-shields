## CMakeLists.txt
```
# SPDX-License-Identifier: Apache-2.0

cmake_minimum_required(VERSION 3.20.0)
find_package(Zephyr REQUIRED HINTS $ENV{ZEPHYR_BASE})
project(adafruit_winc1500)

FILE(GLOB app_sources src/*.c)
target_sources(app PRIVATE ${app_sources})
```

## prj.conf
```kconfig
CONFIG_SPI=y
CONFIG_NETWORKING=y
CONFIG_NET_IPV4=y
CONFIG_ZTEST=y

# WIFI_WINC1500 (drivers/wifi/winc1500/Kconfig.winc1500) selects
# NET_L2_WIFI_MGMT and WIFI_OFFLOAD once DT_HAS_ATMEL_WINC1500_ENABLED is
# true, which needs NETWORKING already enabled to reach; the driver
# pulls in sys_rand_get(), same rationale eth_click's own suite already
# recorded (this board's SoC chain carries a disabled RNG node, and
# enabling it is board content, not this suite's job).
CONFIG_TEST_RANDOM_GENERATOR=y
```

## src/main.c
```c
/*
 *
 * SPDX-License-Identifier: Apache-2.0
 */
#include <zephyr/ztest.h>

ZTEST(adafruit_winc1500, test_dummy)
{
}

ZTEST_SUITE(adafruit_winc1500, NULL, NULL, NULL, NULL, NULL);
```
