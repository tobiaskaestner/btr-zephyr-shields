## CMakeLists.txt
```
# SPDX-License-Identifier: Apache-2.0

cmake_minimum_required(VERSION 3.20.0)
find_package(Zephyr REQUIRED HINTS $ENV{ZEPHYR_BASE})
project(eth_click)

FILE(GLOB app_sources src/*.c)
target_sources(app PRIVATE ${app_sources})
```

## prj.conf
```kconfig
CONFIG_SPI=y
CONFIG_NETWORKING=y
CONFIG_NET_L2_ETHERNET=y
CONFIG_ZTEST=y

# Networking pulls sys_rand_get(), which has no provider on this board:
# quail's SoC chain does carry an `st,stm32-rng` node (via stm32f405.dtsi)
# but it is status = "disabled", and enabling it needs a devicetree
# overlay -- board content, which does not belong in a shield's test
# suite. The kernel's test-grade PRNG is the right answer for a suite that
# only builds: the link is what is under test here, not randomness quality.
CONFIG_TEST_RANDOM_GENERATOR=y
```

## src/main.c
```c
/*
 *
 * SPDX-License-Identifier: Apache-2.0
 */
#include <zephyr/ztest.h>

ZTEST(eth_click, test_dummy)
{
}

ZTEST_SUITE(eth_click, NULL, NULL, NULL, NULL, NULL);
```
