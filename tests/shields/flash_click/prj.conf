## CMakeLists.txt
```
# SPDX-License-Identifier: Apache-2.0

cmake_minimum_required(VERSION 3.20.0)
find_package(Zephyr REQUIRED HINTS $ENV{ZEPHYR_BASE})
project(flash_click)

FILE(GLOB app_sources src/*.c)
target_sources(app PRIVATE ${app_sources})
```

## prj.conf
```kconfig
CONFIG_SPI=y
CONFIG_FLASH=y
CONFIG_ZTEST=y
```

## src/main.c
```c
/*
 *
 * SPDX-License-Identifier: Apache-2.0
 */
#include <zephyr/ztest.h>

ZTEST(flash_click, test_dummy)
{
}

ZTEST_SUITE(flash_click, NULL, NULL, NULL, NULL, NULL);
```
